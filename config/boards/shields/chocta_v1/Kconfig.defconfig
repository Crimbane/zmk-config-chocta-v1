## config/boards/shields/chocta_v1/Kconfig.defconfig
```kconfig
if SHIELD_CHOCTA_V1_LEFT

config ZMK_KEYBOARD_NAME
	default "ChoctaV1"
	
config ZMK_SPLIT_ROLE_CENTRAL
	default y
	
endif

if SHIELD_CHOCTA_V1_LEFT || SHIELD_CHOCTA_V1_RIGHT

config ZMK_SPLIT
	default y
	
endif
```

## config/boards/shields/chocta_v1/Kconfig.shield
```kconfig
config SHIELD_CHOCTA_V1_LEFT
	def_bool $(shields_list_contains,chocta_v1_left)
	
config SHIELD_CHOCTA_V1_RIGHT
	def_bool $(shields_list_contains,chocta_v1_right)
	
config SHIELD_NICE_NANO_V2
	def_bool $(shields_list_contains,nice_nano_v2)
```
